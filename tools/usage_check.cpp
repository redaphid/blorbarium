// The caller's view as compilable code. syntax_check.sh compiles it with
// -fsyntax-only; nothing links. If a header changes and this stops compiling,
// the usage sketch in DESIGN.md and the headers have diverged.
#include <cassert>
#include <map>
#include <string>
#include "blorb/dish.h"
#include "paint/sprite_pack.h"

using namespace blorb;

// ---- test doubles (test/support/ in the repo) ----------------------------------
struct MemStorage : Storage {
  std::map<std::string, std::vector<uint8_t>> files;
  std::optional<size_t> read(const char* name, size_t offset, uint8_t* buf, size_t cap) override;
  bool writeAtomic(const char* name, const uint8_t* data, size_t len) override;
  bool append(const char* name, const uint8_t* data, size_t len) override;
  bool rename(const char* from, const char* to) override;
  size_t size(const char* name) override;
};
struct NullLink : Link {
  bool connected() override { return false; }
  std::optional<std::string_view> readLine() override { return std::nullopt; }
  void writeLine(std::string_view) override {}
};

// ---- 1. firmware loop (src/main.cpp, the only file with Arduino, LGFX, NimBLE) ----
BodySample readImu();                       // src/hw/imu_qmi8658.h: one 6-byte read + tap code + BOOT
void pushToPanel(const paint::Canvas240&);  // display.h + board_*.h, copied from claude-notification-screen
uint32_t millisNow();
uint32_t speciesSeedFromMac();
uint64_t lineageIdFromMac();
const paint::SpritePack& grungoPack();      // pets/grungo/grungo_pack.h, generated by tools/sprite_pack.py

void firmwareLoop(Dish& dish, Link& nus, paint::Canvas240& canvas, uint32_t& lastSample, uint32_t& lastFrame) {
  uint32_t now = millisNow();
  if (now - lastSample >= kSampleMs) { dish.sample(readImu(), now); lastSample = now; }   // 50 Hz
  dish.tick(now, nus);                                                                  // 10 Hz inside
  if (now - lastFrame >= 33) {
    paint::draw(dish.appearance(), grungoPack(), canvas);
    pushToPanel(canvas);
    lastFrame = now;
  }
}

// ---- 2. host tests (pio test -e native, gtest in the repo; plain bools here) ------
BodySample still() { BodySample s; s.az = 1000; return s; }
BodySample jolt(bool up) { BodySample s; s.az = up ? 2600 : -600; return s; }

// Run whole ticks with the dish at rest, sampling at 50 Hz like the firmware.
void runFor(Dish& dish, Link& link, uint32_t& ms, uint32_t forMs) {
  for (uint32_t end = ms + forMs; ms < end; ms += kSampleMs) {
    dish.sample(still(), ms);
    dish.tick(ms, link);
  }
}

bool shakeMakesHimHop() {   // ask 8
  MemStorage store; NullLink link; uint32_t ms = 0;
  Dish dish(store, /*speciesSeed=*/7, /*lineageId=*/1);
  while (!std::holds_alternative<Creature>(dish.occupant())) runFor(dish, link, ms, 60000);   // incubate, hatch
  for (int i = 0; i < 8; ++i, ms += 80) { dish.sample(jolt(i % 2 == 0), ms); dish.tick(ms, link); }  // 4 jolts past 0.55 g in 640 ms
  runFor(dish, link, ms, 300);
  Appearance a = dish.appearance();
  return a.reflexActive && a.reflex == reflex::hop && a.expression == expr::alarmed && a.reflexStrength > Fx::zero();
}

bool foreseeAlwaysGlows() {   // ask 7
  MemStorage store; NullLink link; uint32_t ms = 0;
  Dish dish(store, 7, 1);
  while (!std::holds_alternative<Creature>(dish.occupant())) runFor(dish, link, ms, 60000);
  for (int i = 0; i < 100000; ++i) {
    runFor(dish, link, ms, kTickMs);
    const Creature& c = std::get<Creature>(dish.occupant());
    if (c.action() == action::foresee) return dish.appearance().glow >= kForeseeGlowFloor;
  }
  return false;
}

bool buttonFeedsWithNoPhone() {   // ask 4: no Link ever connects
  MemStorage store; NullLink link; uint32_t ms = 0;
  Dish dish(store, 7, 1);
  while (!std::holds_alternative<Creature>(dish.occupant())) runFor(dish, link, ms, 60000);
  uint8_t before = dish.habitat().pantry;
  BodySample press = still(); press.buttonDown = true;
  for (int i = 0; i < 10; ++i, ms += kSampleMs) { dish.sample(press, ms); dish.tick(ms, link); }
  runFor(dish, link, ms, 200);   // release under 1.2 s = Button = a pellet
  return dish.habitat().pantry + 1 == before;
}

bool everyAncestorReplays(const Lineage& lineage, const std::vector<uint32_t>& bornHashes) {
  for (uint16_t g = 0; g < bornHashes.size(); ++g) {
    std::optional<Genome> genome = lineage.genomeOf(g);
    if (!genome || genome->hash() != bornHashes[g]) return false;
  }
  return true;
}

bool diffReplaysToChild(const Genome& parent, Rng& rng) {
  Offspring o = mutate(parent, policyOf(parent, Fx::zero()), {}, rng);
  std::optional<Genome> again = apply(parent, o.diff);
  return again && again->bytes() == o.genome.bytes() && viability(o.genome).ok;
}

bool clutchIsDeterministic(const Clutch& c) {
  return c.count >= 1 && c.child(0).genome.bytes() == c.child(0).genome.bytes();
}

// ---- 3. registries are the extension surface ------------------------------------
static_assert(kFeatureCount == FEATURES.size(), "feature vector derives from the rows");
static_assert(locus::recent(stim::shake) == LocusId{66}, "recent loci derive from stimulus ids");
static_assert(REFLEXES[reflex::hop.v].trigger == locus::startle, "the hop rides the startle locus");
static_assert(GENE_TYPES[0].type == 0x01 && GENE_TYPES[0].bodyLen == sizeof(ChemGene), "gene table derives from gene_kinds.def");
static_assert(expressedAt(GeneHeader{0x20, 6, 0, Stage::Adult, 2, 64, GeneUid{9}}, Stage::Adult, feat::reached_elder),
              "featGate 2 = feat bit 1 = reached_elder");
static_assert(!expressedAt(GeneHeader{0x20, 6, 0, Stage::Adult, 2, 64, GeneUid{9}}, Stage::Adult, feat::reached_adult),
              "a feat-gated gene stays quiet until the lineage earns it");

int main() {
  bool ok = shakeMakesHimHop() && foreseeAlwaysGlows() && buttonFeedsWithNoPhone();
  return ok ? 0 : 1;
}
